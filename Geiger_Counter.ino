#include "FS.h"
#include "Button.h"

#include <SPI.h>
#include <TFT_eSPI.h>

#define CALIBRATION_FILE "/TouchCalData2"
#define REPEAT_CAL false

#define TOP_X
#define TOP_Y

#define InterruptPin 27

uint16_t t_x = 0, t_y = 0; //the touch coordinates
boolean pressed = false; //true if valid press on the screen occured
boolean previousState = false;

TFT_eSPI tft = TFT_eSPI();

int pageNumber = 1;
int currentPage = 0;
int padding = tft.textWidth("99.9", 8);

//Variables for radiation measurement
int CPM = 0;

static const uint8_t gear[2048] PROGMEM = {
    0x00, 0x00, 0x00, 0x00, 0x00, 0x00, 0x00, 0x00, 0x00, 0x00, 0x00, 0x00, 0x00, 0x00, 0x00, 0x00, 
    0x00, 0x00, 0x00, 0x00, 0x00, 0x00, 0x00, 0x00, 0x00, 0x00, 0x00, 0x00, 0x00, 0x00, 0x00, 0x00, 
    0x00, 0x00, 0x00, 0x00, 0x00, 0x00, 0x00, 0x00, 0x00, 0x00, 0x00, 0x00, 0x00, 0x00, 0x00, 0x00, 
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    0x00, 0x00, 0x00, 0x00, 0x00, 0x00, 0x00, 0x00, 0x00, 0x00, 0x00, 0x00, 0x00, 0x00, 0x00, 0x00
};

Button options(192, 245, 128, 128, gear, 128, 128, 35, TFT_SILVER, TFT_WHITE, TFT_BLUE, &tft);

void setup(){
  tft.init();
  tft.setRotation(2);
  touch_calibrate();

  //ISR initialization
  pinMode(InterruptPin, INPUT_PULLDOWN);
  attachInterrupt(InterruptPin, countEvent, RISING);
  
}

void loop(){

  pressed = tft.getTouch(&t_x, &t_y);
  if(pressed != previousState){
      handleTouchCurrentPage();
      previousState = pressed;
  }
  
  if(currentPage != pageNumber){
    drawNextPage();
    currentPage = pageNumber;
  }
  updateCurrentPage();
  delay(100);
}

void drawNextPage(){
  tft.fillScreen(TFT_BLACK);
    switch(pageNumber){
      case 1:
        drawPageOne();
      break;
      case 2:
        drawPageTwo();
      break;
    }
}

void updateCurrentPage(){
  switch(pageNumber){
    case 1:
      updatePageOne();
    break;
    case 2:
      updatePageTwo();
    break;
  }
}

void handleTouchCurrentPage(){ 
  switch(pageNumber){
    case 1:
      handleTouchPageOne();
    break;
    case 2:
      handleTouchPageTwo();
    break;
  }
}

void drawPageOne(){
  tft.fillRoundRect(0, 25, 320, 210, 10, TFT_SILVER);
  tft.setCursor(200, 128);
  tft.loadFont("Unit");
  tft.setTextColor(TFT_WHITE, TFT_SILVER);
  tft.print("µSv/h");
  tft.unloadFont();
  //drawBitmapButton(192, 245, 128, 128, gear, 128, 128, 35, TFT_SILVER, TFT_WHITE);
  //Button options(192, 245, 128, 128, gear, 128, 128, 35, TFT_SILVER, TFT_WHITE, TFT_BLUE, &tft);
  options.init();
}

void drawPageTwo(){
  tft.fillRoundRect(0, 25, 320, 64, 10, TFT_SILVER);
}

void updatePageOne(){
  tft.setTextDatum(TR_DATUM);
  tft.setTextColor(TFT_WHITE, TFT_SILVER);
  tft.setTextPadding(padding);
  tft.drawFloat(CPM, 1, padding, 85, 8);
}

void updatePageTwo(){
  
}

void handleTouchPageOne(){
  if(t_x > 192 && t_y > 285 && t_y < 413){
    if(pressed){
      //drawBitmapButton(192, 245, 128, 128, gear, 128, 128, 35, TFT_BLUE, TFT_WHITE);
      options.press();
    }else{
      //drawBitmapButton(192, 245, 128, 128, gear, 128, 128, 35, TFT_SILVER, TFT_WHITE);
      options.unPress();
      pageNumber = 2;
    }
  }
}

void handleTouchPageTwo(){
  
}

void countEvent(){
  CPM++;
}

void touch_calibrate(){
  uint16_t calData[5];
  uint8_t calDataOK = 0;

  // check file system exists
  if (!SPIFFS.begin()){
    SPIFFS.format();
    SPIFFS.begin();
  }

  // check if calibration file exists and size is correct
  if (SPIFFS.exists(CALIBRATION_FILE)){
    if (REPEAT_CAL)
    {
      // Delete if we want to re-calibrate
      SPIFFS.remove(CALIBRATION_FILE);
    }
    else
    {
      File f = SPIFFS.open(CALIBRATION_FILE, "r");
      if (f) {
        if (f.readBytes((char *)calData, 14) == 14)
          calDataOK = 1;
        f.close();
      }
    }
  }

  if (calDataOK && !REPEAT_CAL){
    // calibration data valid
    tft.setTouch(calData);
  } else {
    // data not valid so recalibrate
    tft.fillScreen(TFT_BLACK);
    tft.setCursor(20, 0);
    tft.setTextSize(1);
    tft.setTextColor(TFT_WHITE, TFT_BLACK);

    tft.println("Touch corners as indicated");

    tft.setTextFont(1);
    tft.println();

    if (REPEAT_CAL) {
      tft.setTextColor(TFT_RED, TFT_BLACK);
    }

    tft.calibrateTouch(calData, TFT_MAGENTA, TFT_BLACK, 15);

    tft.setTextColor(TFT_GREEN, TFT_BLACK);
    tft.println("Calibration complete!");

    // store data
    File f = SPIFFS.open(CALIBRATION_FILE, "w");
    if (f) {
      f.write((const unsigned char *)calData, 14);
      f.close();
    }
  }
}
